## iplatform/stable/opensource/minidlna/Config.in
```kconfig
config minidlna-parse-media
	bool "parsing media files support"
	default y
	depends PACKAGE_minidlna
	select  PACKAGE_libexif
	select  PACKAGE_libflac
	select  PACKAGE_libjpeg
	select  PACKAGE_libtiff
	select  PACKAGE_libvorbis
	depends PACKAGE_libffmpeg-custom||PACKAGE_libffmpeg-full||PACKAGE_libffmpeg-mini
	help
	  Feature: provide parsing media files support.

config minidlna-staticlink
	bool "linked with some static libs"
	default n
	depends PACKAGE_minidlna
	select libffmpeg-staticlib if minidlna-parse-media
	select libsqlite3-staticlib
	select libtiff-staticlib if minidlna-parse-media
	select libflac-staticlib if minidlna-parse-media
	select libvorbis-staticlib if minidlna-parse-media
```

## package/broadcom-wl/Config.in
```kconfig
config BCM_SDK6X
	bool "use BCM SDK6.X"
	default n
    depends PACKAGE_kmod-brcm-wl

config BCM_SDK7X
	bool "use BCM SDK7.X"
	default n
    depends PACKAGE_kmod-brcm-wl
```

## sdk/rt288x/linux/kernels/linux-2.6.36.x/net/bridge/Kconfig
```kconfig
#
# 802.1d Ethernet Bridging
#

config BRIDGE
	tristate "802.1d Ethernet Bridging"
	select LLC
	select STP
	---help---
	  If you say Y here, then your Linux box will be able to act as an
	  Ethernet bridge, which means that the different Ethernet segments it
	  is connected to will appear as one Ethernet to the participants.
	  Several such bridges can work together to create even larger
	  networks of Ethernets using the IEEE 802.1 spanning tree algorithm.
	  As this is a standard, Linux bridges will cooperate properly with
	  other third party bridge products.

	  In order to use the Ethernet bridge, you'll need the bridge
	  configuration tools; see <file:Documentation/networking/bridge.txt>
	  for location. Please read the Bridge mini-HOWTO for more
	  information.

	  If you enable iptables support along with the bridge support then you
	  turn your bridge into a bridging IP firewall.
	  iptables will then see the IP packets being bridged, so you need to
	  take this into account when setting up your firewall rules.
	  Enabling arptables support when bridging will let arptables see
	  bridged ARP traffic in the arptables FORWARD chain.

	  To compile this code as a module, choose M here: the module
	  will be called bridge.

	  If unsure, say N.

config BRIDGE_IGMP_SNOOPING
	bool "IGMP/MLD snooping"
	depends on BRIDGE
	depends on INET
	default y
	---help---
	  If you say Y here, then the Ethernet bridge will be able selectively
	  forward multicast traffic based on IGMP/MLD traffic received from
	  each port.

	  Say N to exclude this support and reduce the binary size.

	  If unsure, say Y.

config BRIDGE_DELIVER_CONTROL
	bool "Bridge deliver controlling"
	depends on BRIDGE
	depends on INET
	default n
	---help---
	  Bridge deliver controlling required for some dual band repeaters, such
	  as wa3500re(EU) 1.0.
	  
	  what does "Bridge deliver controlling" do?
	  It is designed for "Link Backup" && "Link Restoration".
	  For dual band repeaters, in concurrent mode, there are 2.4GHz link and
	  5GHz link between the repeater and root AP. When one link is down, e.g.
	  2.4GHz link is down, then the data from 2.4GHz device should automatically
	  switch to 5GHz link. When 2.4GHz link is restored, data from 2.4GHz device
	  should switch back to 2.4GHz link. It's the same when 5Ghz link is down.
	  
	  Data from LAN port goes to 2.4GHz link by default. When 2.4GHz is down, the
	  data should automatically switch to 5GHz link. When 2.4GHz is restored, the
	  data should go back to 2.4GHz link.
	
	  If you say Y here, then the Ethernet bridge will be able selectively
	  to forward packets based on packets received from each sub-iface.
```
